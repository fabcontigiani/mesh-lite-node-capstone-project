## main/Kconfig.projbuild
```kconfig
menu "Mesh Configuration"

config ROUTER_SSID
    string "Router SSID"
        default "ROUTER_SSID"
        help
            SSID of the WiFi router to connect to.
            This router provides internet access to the root node.

config ROUTER_PASSWORD
    string "Router password"
        default "ROUTER_PASSWORD"
        help
            Password of the WiFi router.

choice MESH_NODE_ROLE
    prompt "Node Role"
    default MESH_LEAF
    help
        Select the role for this device in the mesh network.
        
        ROOT: Mesh coordinator, always on, connects to router.
        RELAY: Network extender, Light Sleep + Modem PS, allows children.
        LEAF: Sensor node, Deep Sleep + ULP, no children.

config MESH_ROOT
    bool "Root Node - Mesh coordinator (always on)"
    help
        This device will ONLY operate as root node (level 1).
        It connects directly to the router and cannot be a child node.
        The root node NEVER enters deep sleep - it maintains the mesh 24/7.

config MESH_RELAY
    bool "Relay Node - Network extender (Light Sleep)"
    help
        This device operates as an intermediate relay node.
        It uses Light Sleep + Modem Power Save for energy efficiency
        while maintaining mesh connectivity and allowing child nodes.
        Uses GPIO interrupt for PIR detection (not ULP).
        
        See docs/POWER_MANAGEMENT.md for details.

config MESH_LEAF
    bool "Leaf Node - Sensor (Deep Sleep + ULP)"
    help
        This device operates as a leaf (terminal) node.
        It uses Deep Sleep + ULP co-processor for ultra-low power.
        When sleeping, it disconnects from mesh and cannot have children.
        Uses ULP polling for PIR detection.

endchoice

menu "Relay Node Configuration"
    depends on MESH_RELAY

config RELAY_PIR_GPIO
    int "PIR Sensor GPIO pin"
    default 12
    range 0 39
    help
        GPIO pin connected to the PIR motion sensor.
        Uses normal GPIO interrupt (not RTC/ULP).
        Default: GPIO12

config RELAY_AWAKE_TIME_MS
    int "Time to stay active after motion (ms)"
    default 60000
    range 10000 600000
    help
        How long the relay node stays fully active after detecting motion.
        During this time it processes the event and stays responsive.
        Default: 60000 (60 seconds)

config RELAY_STATUS_INTERVAL_MS
    int "Status log interval (ms)"
    default 30000
    range 5000 300000
    help
        How often to print status information (mesh level, children, etc).
        Default: 30000 (30 seconds)

endmenu

menu "Leaf Node Configuration"
    depends on MESH_LEAF

config LEAF_PIR_GPIO
    int "PIR Sensor GPIO pin"
    default 12
    range 0 39
    help
        GPIO pin connected to the PIR motion sensor.
        Must be an RTC-capable GPIO for ULP access.
        Default: GPIO12 (RTC_GPIO15)

config LEAF_AWAKE_TIME_MS
    int "Time to stay awake after motion (ms)"
    default 30000
    range 5000 300000
    help
        How long the leaf node stays awake after detecting motion.
        During this time it connects to mesh and processes the event.
        Default: 30000 (30 seconds)

config LEAF_ULP_POLL_PERIOD_US
    int "ULP PIR polling period (microseconds)"
    default 100000
    range 10000 1000000
    help
        How often the ULP co-processor checks the PIR sensor.
        Lower values = faster detection but higher power consumption.
        Default: 100000 (100ms = 10 checks per second)

endmenu

endmenu
```

## sdkconfig.defaults
```kconfig
# Override some defaults in mesh application project.

#
# FreeRTOS
#
CONFIG_FREERTOS_HZ=1000
CONFIG_FREERTOS_TIMER_TASK_STACK_DEPTH=3072
CONFIG_FREERTOS_USE_TRACE_FACILITY=y
CONFIG_FREERTOS_USE_STATS_FORMATTING_FUNCTIONS=y
CONFIG_FREERTOS_VTASKLIST_INCLUDE_COREID=y
CONFIG_FREERTOS_GENERATE_RUN_TIME_STATS=y

#
# Power Management (required for Light Sleep in relay nodes)
#
CONFIG_PM_ENABLE=y
CONFIG_FREERTOS_USE_TICKLESS_IDLE=y

#
# ESP32-specific
#
CONFIG_ESP_TASK_WDT_PANIC=y
CONFIG_ESP_TASK_WDT_TIMEOUT_S=10
CONFIG_ESP_TIMER_TASK_STACK_SIZE=4096

# LWIP
CONFIG_LWIP_IP_FORWARD=y
CONFIG_LWIP_IPV4_NAPT=y

CONFIG_MESH_LITE_ENABLE=y

# Disable Ethernet (not used in this project)
CONFIG_BRIDGE_ETHERNET_NETIF_ENABLE=n

CONFIG_BRIDGE_SOFTAP_SSID_END_WITH_THE_MAC=y

#
# ULP Co-processor (for leaf nodes)
#
CONFIG_ULP_COPROC_ENABLED=y
CONFIG_ULP_COPROC_TYPE_FSM=y
CONFIG_ULP_COPROC_RESERVE_MEM=512

#
# PSRAM (Required for ESP32-CAM)
#
CONFIG_ESP32_SPIRAM_SUPPORT=y
CONFIG_SPIRAM=y
CONFIG_SPIRAM_TYPE_AUTO=y
CONFIG_SPIRAM_SPEED_40M=y
CONFIG_SPIRAM_USE_MALLOC=y

#
# Camera
#
CONFIG_CAMERA_MODULE_ESP32_CAM=y

#
# Partition Table
#
CONFIG_PARTITION_TABLE_CUSTOM=y
CONFIG_PARTITION_TABLE_CUSTOM_FILENAME="partitions.csv"

#
# IRAM Optimization (Required for WiFi + Camera + SD FAT)
# Moving code to flash to free up IRAM space
#
CONFIG_COMPILER_OPTIMIZATION_SIZE=y
CONFIG_COMPILER_OPTIMIZATION_ASSERTIONS_SILENT=y

# Move WiFi RX/TX buffers to PSRAM
CONFIG_ESP_WIFI_DYNAMIC_RX_BUFFER_NUM=16
CONFIG_ESP_WIFI_STATIC_RX_BUFFER_NUM=4
CONFIG_ESP_WIFI_RX_BA_WIN=6
CONFIG_ESP_WIFI_CACHE_TX_BUFFER_NUM=16

# Move more code to flash
CONFIG_FREERTOS_PLACE_FUNCTIONS_INTO_FLASH=y

# FAT filesystem long filename support
CONFIG_FATFS_LFN_HEAP=y
CONFIG_FATFS_MAX_LFN=255
```
